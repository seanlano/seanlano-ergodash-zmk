## boards/shields/ergodash_wired/Kconfig.defconfig
```kconfig
# Copyright (c) 2020 The ZMK Contributors
# SPDX-License-Identifier: MIT

if SHIELD_ERGODASH_WIRED_LEFT

config ZMK_KEYBOARD_NAME
    default "Ergodash Wired"

config ZMK_SPLIT_ROLE_CENTRAL
    default y

endif

if SHIELD_ERGODASH_WIRED_LEFT || SHIELD_ERGODASH_WIRED_RIGHT

config ZMK_SPLIT
    default y

endif
```

## boards/shields/ergodash_wired/Kconfig.shield
```kconfig
# Copyright (c) 2020 The ZMK Contributors
# SPDX-License-Identifier: MIT

config SHIELD_ERGODASH_WIRED_LEFT
    def_bool $(shields_list_contains,ergodash_wired_left)

config SHIELD_ERGODASH_WIRED_RIGHT
    def_bool $(shields_list_contains,ergodash_wired_right)
```
